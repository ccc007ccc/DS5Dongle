## m61/dualsense_hidp_probe/defconfig
```kconfig
CONFIG_BFLB_LOG =n
CONFIG_FREERTOS =y
CONFIG_SHELL =y
CONFIG_CONSOLE_UART_BAUDRATE =115200
CONFIG_CHERRYUSB =y
CONFIG_CHERRYUSB_OSAL =freertos
CONFIG_CHERRYUSB_DEVICE =y
CONFIG_CHERRYUSB_DEVICE_HID =y
CONFIG_CHERRYUSB_DEVICE_AUDIO =y
CONFIG_USB_EHCI_HCOR_RESERVED_DISABLE =y
CONFIG_MULTIMEDIA =y
CONFIG_OPUS =y
CONFIG_BLUETOOTH =y
CONFIG_RF =y

CONFIG_BTBLECONTROLLER_LIB =ble1m2s1bredr1
CONFIG_BLE_USE_MAC2 =n
CONFIG_BT_BREDR =y
CONFIG_BT_A2DP =n
CONFIG_BT_AVRCP =n
CONFIG_BT_HFP =n
CONFIG_BT_SPP =n
CONFIG_BT_MESH =n
CONFIG_BT_STACK_CLI =n

CONFIG_BT_SETTINGS =y
CONFIG_BFLB_MTD =y
CONFIG_PARTITION =y
CONFIG_LITTLEFS =y

CONFIG_M61_STATUS_LED_ENABLE =y
CONFIG_M61_STATUS_LED_ACTIVE_HIGH =y
CONFIG_M61_STATUS_LED_RED_PIN =12
CONFIG_M61_STATUS_LED_GREEN_PIN =14
CONFIG_M61_STATUS_LED_BLUE_PIN =15
CONFIG_M61_STATUS_LED_BLINK_MS =250
CONFIG_M61_USB_GAMEPAD_ENABLE =y
CONFIG_M61_DS5_BRIDGE_HAPTICS_GAIN_Q8 =256
CONFIG_M61_DS5_BRIDGE_SPEAKER_VOLUME =100
CONFIG_M61_DS5_BRIDGE_HEADSET_VOLUME =100
CONFIG_M61_DS5_BRIDGE_SPEAKER_GAIN =2
CONFIG_M61_DS5_BRIDGE_INACTIVE_TIME_MIN =30
CONFIG_M61_DS5_BRIDGE_POLLING_RATE_MODE =1
CONFIG_M61_DS5_BRIDGE_AUDIO_BUFFER_LENGTH =64
CONFIG_M61_DS5_BRIDGE_CONTROLLER_MODE =2
CONFIG_M61_DS5_BRIDGE_ENABLE_USB_SN =1
CONFIG_M61_DS5_BRIDGE_PS_SHORTCUT_ENABLED =0
CONFIG_M61_DS5_BRIDGE_DISABLE_MIC =0
CONFIG_M61_DS5_BRIDGE_DISABLE_SPEAKER =0
CONFIG_M61_DS5_BRIDGE_ENABLE_WAKE =0
CONFIG_M61_DS5_BRIDGE_TRIGGER_REDUCE =0
CONFIG_M61_DS5_BRIDGE_LOCK_VOLUME =0
CONFIG_M61_DS5_DUAL_CHIP_TRANSPORT =n
CONFIG_M61_ESP32_SPI_ENABLE =n
CONFIG_M61_ESP32_SPI_READY =n
CONFIG_M61_ESP32_SPI_SCLK_PIN =255
CONFIG_M61_ESP32_SPI_MOSI_PIN =255
CONFIG_M61_ESP32_SPI_MISO_PIN =255
CONFIG_M61_ESP32_SPI_CS_PIN =255
CONFIG_M61_ESP32_SPI_FREQ_HZ =1000000
CONFIG_M61_ESP32_READY_PIN =255
CONFIG_M61_ESP32_IRQ_PIN =255
CONFIG_M61_ESP32_RESET_PIN =255
CONFIG_M61_ESP32_RX_POLL_ENABLE =n
CONFIG_M61_ESP32_RX_POLL_INTERVAL_MS =1
CONFIG_M61_ESP32_ACK_POLL_COUNT =1
CONFIG_M61_ESP32_RELIABLE_RETRY_COUNT =1
CONFIG_M61_ESP32_TIME_SYNC_INTERVAL_MS =1000
CONFIG_M61_ESP32_RESET_PULSE_MS =50
CONFIG_M61_ESP32_RESET_BOOT_MS =750
CONFIG_M61_ESP32_RECOVERY_ERROR_THRESHOLD =8
CONFIG_M61_ESP32_RECOVERY_COOLDOWN_MS =5000

ifeq ($(CHIP),bl618dg)
CONFIG_ROMAPI =n
CONFIG_DUALCORE_DISABLE =y
CONFIG_WRAM_FOR_AP_SIZE = 0x50000
CONFIG_RAM_FOR_AP_SIZE = 0x50000
endif

CONFIG_BACKTRACE =n
```

## m61/esp32_prog_bridge/Kconfig
```kconfig
mainmenu "M61 ESP32 Programming Bridge"

source "$BL_SDK_BASE/Kconfig"

menu "M61 ESP32 programming bridge"

config M61_TARGET_UART_ID
    int "UART id connected to ESP32 UART0"
    default 1
    help
        0 selects uart0, 1 selects uart1. BL616 boards usually expose uart1
        on general-purpose pins; avoid the UART used by the SDK console.

config M61_HOST_UART_ENABLE
    bool "Enable host UART bridge for board CH340"
    default y
    help
        Ai-M61-32S-Kit exposes the BL618 UART0 console through the on-board
        CH340. Enabling this lets the PC use that COM port for bridge commands
        and ESP32 UART forwarding when native USB CDC is not available.

config M61_HOST_UART_ID
    int "UART id connected to PC/CH340"
    default 0

config M61_HOST_UART_BAUD
    int "Fixed host UART baud"
    default 115200

config M61_HOST_UART_TX_PIN
    int "Host UART TX pin"
    default 21

config M61_HOST_UART_RX_PIN
    int "Host UART RX pin"
    default 22

config M61_TARGET_UART_TX_PIN
    int "M61 UART TX pin"
    default 23

config M61_TARGET_UART_RX_PIN
    int "M61 UART RX pin"
    default 24

config M61_BOOT_PIN
    int "M61 GPIO wired to ESP32 BOOT/IO0"
    default 27

config M61_EN_PIN
    int "M61 GPIO wired to ESP32 EN/RST"
    default 28

config M61_MAP_CDC_LINES_TO_BOOT_RESET
    bool "Map CDC DTR/RTS to ESP32 BOOT/EN"
    default n
    help
        Optional compatibility mode for esptool-style serial control lines.
        Direct GPIO wiring may not match transistor-inverted dev-board reset
        circuits, so the text commands are safer and enabled regardless.

endmenu
```

## m61/esp32_prog_bridge/defconfig
```kconfig
CONFIG_FREERTOS=y

CONFIG_CHERRYUSB=y
CONFIG_CHERRYUSB_OSAL=freertos
CONFIG_CHERRYUSB_DEVICE=y
CONFIG_CHERRYUSB_DEVICE_CDC_ACM=y

CONFIG_M61_HOST_UART_ENABLE=y
CONFIG_M61_HOST_UART_ID=0
CONFIG_M61_HOST_UART_BAUD=115200
CONFIG_M61_HOST_UART_TX_PIN=21
CONFIG_M61_HOST_UART_RX_PIN=22
CONFIG_M61_TARGET_UART_ID=1
CONFIG_M61_TARGET_UART_TX_PIN=23
CONFIG_M61_TARGET_UART_RX_PIN=24
CONFIG_M61_BOOT_PIN=27
CONFIG_M61_EN_PIN=28
CONFIG_M61_MAP_CDC_LINES_TO_BOOT_RESET=n
```

## m61/usb_hid_gamepad_probe/defconfig
```kconfig
CONFIG_BFLB_LOG =n
CONFIG_FREERTOS =y
CONFIG_CHERRYUSB =y
CONFIG_CHERRYUSB_OSAL =freertos
CONFIG_CHERRYUSB_DEVICE =y
CONFIG_CHERRYUSB_DEVICE_HID =y
CONFIG_USB_EHCI_HCOR_RESERVED_DISABLE =y
CONFIG_BACKTRACE =n
```

## main/Kconfig.projbuild
```kconfig
menu "DS5 DualSense Bridge"

    config DS5_SCAN_SECONDS
        int "Classic Bluetooth inquiry duration (1.28-second units)"
        range 1 48
        default 30
        help
            Standard HCI inquiry duration units. The default 30 is about
            38.4 seconds. BTstack only accepts values from 1 through 48.

    config DS5_ACCEPT_ANY_GAMEPAD
        bool "Accept first discovered classic Bluetooth gamepad"
        default y
        help
            Keep this enabled during bring-up so a DualSense in pairing mode is
            accepted even if its EIR name is not resolved. Disable it if there
            are other Bluetooth gamepads nearby.

    config DS5_PRINT_RAW_REPORTS
        bool "Print raw HID reports"
        default n
        help
            Dumps each received HID interrupt report at debug level. This is
            useful for protocol investigation but too noisy for normal testing.

    config DS5_LOG_UNCHANGED_MS
        int "State heartbeat interval when inputs do not change"
        range 100 10000
        default 1000
        help
            Parsed input state is always printed when it changes. This interval
            controls the periodic heartbeat when the controller is idle.

    config DS5_BRINGUP_RETRIES
        int "DualSense full-report bring-up attempts"
        range 1 20
        default 8
        help
            Number of feature/output initialization attempts after HID connects.
            Keep this finite: if full 0x31 reports still do not appear, the log
            should show an exhausted bring-up path instead of spamming HID output.

    config DS5_BRINGUP_RETRY_MS
        int "DualSense bring-up retry interval, milliseconds"
        range 100 5000
        default 500
        help
            Delay between repeated DualSense feature/output initialization
            attempts while the controller is still sending only short reports.

    config DS5_RAW_HIDP_AUTO_CONNECT
        bool "Auto-connect to DualSense at startup"
        default y
        help
            Start the saved-address reconnect or inquiry flow right after the
            Bluetooth stack is initialized, so M61 does not need to issue a
            connect command after every ESP32 reboot.

    config DS5_LED_GREEN_GPIO
        int "Green status LED GPIO (-1 disables)"
        range -1 33
        default -1
        help
            GPIO for the controllable green status LED. Many ESP32-WROOM-32
            CH340 boards only have an always-on red power LED and a controllable
            blue GPIO2 LED; keep this at -1 if no green LED is wired to ESP32.

    config DS5_LED_RED_GPIO
        int "Red status LED GPIO (-1 disables)"
        range -1 33
        default -1
        help
            GPIO for a controllable red status LED. If configured, normal
            boot, Bluetooth connecting, and connected states drive it off.
            Keep this at -1 when the red LED is only a power LED tied to the
            board power rail.

    config DS5_LED_BLUE_GPIO
        int "Blue status LED GPIO (-1 disables)"
        range -1 33
        default 2
        help
            GPIO for the controllable blue status LED. GPIO2 is the common
            onboard blue LED on many ESP32-WROOM-32 development boards.

    config DS5_LED_ACTIVE_LOW
        bool "Status LEDs are active low"
        default n
        help
            Enable this if the status LEDs turn on when their GPIO is driven low.

    config DS5_LED_BLINK_MS
        int "Bluetooth connecting blink interval, milliseconds"
        range 100 2000
        default 250
        help
            Blue LED blink interval while scanning or connecting to DualSense.

    config DS5_DUAL_CHIP_SPI_COPROCESSOR
        bool "Run ESP32 as M61 SPI Bluetooth coprocessor"
        default n
        help
            Enables the dual-chip queue boundary: ESP32 receives complete
            DualSense BT output reports from M61 over the SPI protocol and only
            schedules HIDP transport. Hardware SPI pin binding is intentionally
            left to board-specific config until the M61/ESP32 wiring is known.

    config DS5_DUAL_CHIP_TX_QUEUE_DEPTH
        int "Dual-chip ESP32 TX queue depth"
        range 2 16
        default 4
        help
            Number of pending M61-to-ESP32 BT reports kept before latest-wins
            dropping is applied.

    config DS5_DUAL_CHIP_RESPONSE_QUEUE_DEPTH
        int "Dual-chip ESP32 response queue depth"
        range 2 8
        default 8
        depends on DS5_DUAL_CHIP_SPI_COPROCESSOR
        help
            Number of ESP32-to-M61 response frames queued while waiting for
            the M61 SPI master to clock them out. ACK frames are queued ahead
            of latest status/input frames so reliable control traffic is not
            blocked by stale status responses.

    config DS5_DUAL_CHIP_SPI_HOST
        int "Dual-chip ESP32 SPI host peripheral"
        range 2 3
        default 2
        depends on DS5_DUAL_CHIP_SPI_COPROCESSOR
        help
            ESP32 SPI peripheral used as slave. 2 is HSPI/SPI2 on classic
            ESP32-WROOM-32 boards; 3 is VSPI/SPI3.

    config DS5_DUAL_CHIP_SPI_SCLK_GPIO
        int "Dual-chip SPI SCLK GPIO (-1 disables hardware SPI)"
        range -1 39
        default -1
        depends on DS5_DUAL_CHIP_SPI_COPROCESSOR

    config DS5_DUAL_CHIP_SPI_MOSI_GPIO
        int "Dual-chip SPI MOSI GPIO (-1 disables hardware SPI)"
        range -1 39
        default -1
        depends on DS5_DUAL_CHIP_SPI_COPROCESSOR

    config DS5_DUAL_CHIP_SPI_MISO_GPIO
        int "Dual-chip SPI MISO GPIO (-1 disables hardware SPI)"
        range -1 39
        default -1
        depends on DS5_DUAL_CHIP_SPI_COPROCESSOR

    config DS5_DUAL_CHIP_SPI_CS_GPIO
        int "Dual-chip SPI CS GPIO (-1 disables hardware SPI)"
        range -1 39
        default -1
        depends on DS5_DUAL_CHIP_SPI_COPROCESSOR

    config DS5_DUAL_CHIP_ESP_READY_GPIO
        int "ESP_READY GPIO (-1 disables)"
        range -1 39
        default -1
        depends on DS5_DUAL_CHIP_SPI_COPROCESSOR
        help
            Optional ESP32 output driven high after SPI slave initialization.

    config DS5_DUAL_CHIP_ESP_IRQ_GPIO
        int "ESP_IRQ GPIO (-1 disables)"
        range -1 39
        default -1
        depends on DS5_DUAL_CHIP_SPI_COPROCESSOR
        help
            Optional ESP32 output asserted when an input/mic response frame is
            pending for the M61 master to clock out.

endmenu
```

## sdkconfig.defaults
```kconfig
CONFIG_IDF_TARGET="esp32"
CONFIG_BT_ENABLED=y
CONFIG_BT_BLUEDROID_ENABLED=y
CONFIG_BT_CLASSIC_ENABLED=y
CONFIG_BT_BLE_ENABLED=n
CONFIG_BT_HID_ENABLED=y
CONFIG_BT_HID_HOST_ENABLED=y
CONFIG_BT_L2CAP_ENABLED=y
CONFIG_BTDM_CTRL_MODE_BR_EDR_ONLY=y
CONFIG_BTDM_CTRL_BR_EDR_MAX_ACL_CONN=2
CONFIG_BTDM_CTRL_BR_EDR_MAX_SYNC_CONN=0
CONFIG_ESP_MAIN_TASK_STACK_SIZE=6144
CONFIG_LOG_DEFAULT_LEVEL_INFO=y
CONFIG_PARTITION_TABLE_SINGLE_APP=y
CONFIG_DS5_LED_GREEN_GPIO=-1
CONFIG_DS5_LED_BLUE_GPIO=2
CONFIG_DS5_LED_BLINK_MS=250
```
